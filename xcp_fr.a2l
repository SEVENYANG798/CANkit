/* generated by ASAP2 Studio 2.1.70.9969 */
/* 0K0H40AATWWA-EP2 A2L (TC397, Vector XCP on CAN, CRO 0x06A6 / DTO ext 0x46A7)
* Transport layer, DAQ events, memory segments and command set aligned with the ECU configuration
* (Xcp_Cfg.h, CanIf_Lcfg.c, CanXcp_Lcfg.c - DaVinci 5.27.35, generated 2026-05-16).
* NOTE: Calibration parameters and measurements are not included yet.
*/ ASAP2_VERSION 1 61
/begin PROJECT K0H40AATWWA ""
/begin MODULE K0H40AATWWA_EP2 ""
/begin MOD_PAR ""
 /begin MEMORY_SEGMENT CalFlash "" DATA FLASH INTERN 0xA0340000 0x90000 -1 -1 -1 -1 -1
  /begin IF_DATA XCPplus 0x0102
   /begin SEGMENT 0x00 0x02 0x00 0x00 0x00 /begin CHECKSUM XCP_CRC_32 MAX_BLOCK_SIZE 256 /end CHECKSUM
    /begin PAGE 0x00 ECU_ACCESS_DONT_CARE XCP_READ_ACCESS_DONT_CARE XCP_WRITE_ACCESS_NOT_ALLOWED /end PAGE
    /begin PAGE 0x01 ECU_ACCESS_DONT_CARE XCP_READ_ACCESS_DONT_CARE XCP_WRITE_ACCESS_WITH_ECU_ONLY /end PAGE
   /end SEGMENT
  /end IF_DATA
 /end MEMORY_SEGMENT
 /begin MEMORY_SEGMENT Code "" CODE FLASH INTERN 0x80030000 0x430000 -1 -1 -1 -1 -1 /end MEMORY_SEGMENT
/end MOD_PAR
/begin MOD_COMMON "" DEPOSIT ABSOLUTE BYTE_ORDER MSB_LAST ALIGNMENT_BYTE 1 ALIGNMENT_WORD 2 ALIGNMENT_LONG 4 ALIGNMENT_FLOAT32_IEEE 4 ALIGNMENT_FLOAT64_IEEE 8 ALIGNMENT_INT64 8 /end MOD_COMMON
/begin IF_DATA XCPplus 0x0102
 /begin XCP_ON_CAN 0x0102 CAN_ID_MASTER 0x06A6 CAN_ID_SLAVE 0x400006A7 BAUDRATE 0x07A120 SAMPLE_POINT 0x50 SAMPLE_RATE SINGLE BTL_CYCLES 0xA0 SJW 0x20
  /begin CAN_FD MAX_DLC 0x08 CAN_FD_DATA_TRANSFER_BAUDRATE 0x1E8480 SAMPLE_POINT 0x46 BTL_CYCLES 0x28 SJW 0x01 SECONDARY_SAMPLE_POINT 0x00 TRANSCEIVER_DELAY_COMPENSATION OFF /end CAN_FD
  MAX_BUS_LOAD 0x64 /begin EVENT_CAN_ID_LIST 0x00 FIXED 0x400046A7 /end EVENT_CAN_ID_LIST /begin EVENT_CAN_ID_LIST 0x01 FIXED 0x400046A7 /end EVENT_CAN_ID_LIST /begin EVENT_CAN_ID_LIST 0x02 FIXED 0x400046A7 /end EVENT_CAN_ID_LIST /begin EVENT_CAN_ID_LIST 0x03 FIXED 0x400046A7 /end EVENT_CAN_ID_LIST /begin EVENT_CAN_ID_LIST 0x04 FIXED 0x400046A7 /end EVENT_CAN_ID_LIST
  /begin PROTOCOL_LAYER 0x0102 0x07D0 0x2710 0x07D0 0x07D0 0x07D0 0x07D0 0x00 0x08 0x08 BYTE_ORDER_MSB_LAST ADDRESS_GRANULARITY_BYTE OPTIONAL_CMD GET_COMM_MODE_INFO OPTIONAL_CMD SET_REQUEST OPTIONAL_CMD SET_MTA OPTIONAL_CMD UPLOAD OPTIONAL_CMD SHORT_UPLOAD OPTIONAL_CMD BUILD_CHECKSUM /* OPTIONAL_CMD TRANSPORT_LAYER_CMD */ OPTIONAL_CMD DOWNLOAD OPTIONAL_CMD SET_CAL_PAGE OPTIONAL_CMD GET_CAL_PAGE OPTIONAL_CMD SET_DAQ_PTR OPTIONAL_CMD WRITE_DAQ OPTIONAL_CMD SET_DAQ_LIST_MODE OPTIONAL_CMD GET_DAQ_LIST_MODE OPTIONAL_CMD START_STOP_DAQ_LIST OPTIONAL_CMD START_STOP_SYNCH OPTIONAL_CMD GET_DAQ_PROCESSOR_INFO OPTIONAL_CMD FREE_DAQ OPTIONAL_CMD ALLOC_DAQ OPTIONAL_CMD ALLOC_ODT OPTIONAL_CMD ALLOC_ODT_ENTRY OPTIONAL_CMD PROGRAM_START OPTIONAL_CMD PROGRAM_CLEAR OPTIONAL_CMD PROGRAM OPTIONAL_CMD PROGRAM_RESET OPTIONAL_CMD GET_PGM_PROCESSOR_INFO OPTIONAL_CMD GET_SECTOR_INFO OPTIONAL_CMD WRITE_DAQ_MULTIPLE COMMUNICATION_MODE_SUPPORTED INTERLEAVED 0x00 /end PROTOCOL_LAYER
  /begin DAQ DYNAMIC 0xE6 0x05 0x00 OPTIMISATION_TYPE_DEFAULT ADDRESS_EXTENSION_FREE IDENTIFICATION_FIELD_TYPE_ABSOLUTE GRANULARITY_ODT_ENTRY_SIZE_DAQ_BYTE 0x07 OVERLOAD_INDICATION_PID RESUME_SUPPORTED /begin STIM GRANULARITY_ODT_ENTRY_SIZE_STIM_BYTE 0x07 /end STIM
   /begin EVENT "XcpEventChannel_5ms" "XcpEvent" 0x00 DAQ 0x1E 0x05 0x06 0x00 /end EVENT
   /begin EVENT "XcpEventChannel_100ms" "XcpEvent" 0x01 DAQ 0x3C 0x64 0x06 0x00 /end EVENT
   /begin EVENT "XcpEventChannel_50ms" "XcpEvent" 0x02 DAQ 0x3C 0x32 0x06 0x00 /end EVENT
   /begin EVENT "XcpEventChannel_20ms" "XcpEvent" 0x03 DAQ 0x28 0x02 0x07 0x00 /end EVENT
   /begin EVENT "XcpEventChannel_10ms" "XcpEvent" 0x04 DAQ 0x28 0x01 0x07 0x00 /end EVENT
  /end DAQ
  /begin PGM PGM_MODE_ABSOLUTE 0x01 0x08 /begin SECTOR "XcpSector" 0x00 0x00680000 0x00100000 0x00 0x00 0x00 /end SECTOR COMMUNICATION_MODE_SUPPORTED INTERLEAVED 0x00 /end PGM
  TRANSPORT_LAYER_INSTANCE "CAN_0_PL0" /end XCP_ON_CAN
/end IF_DATA
/begin RECORD_LAYOUT __Float32_Value FNC_VALUES 1 FLOAT32_IEEE ROW_DIR DIRECT /end RECORD_LAYOUT
/begin RECORD_LAYOUT __ULong_Value FNC_VALUES 1 ULONG ROW_DIR DIRECT /end RECORD_LAYOUT
/begin RECORD_LAYOUT __UWord_Value FNC_VALUES 1 UWORD ROW_DIR DIRECT /end RECORD_LAYOUT
/* @@ELF_MEASUREMENTS@@ */
/end MODULE
/end PROJECT
